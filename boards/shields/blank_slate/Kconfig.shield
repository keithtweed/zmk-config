## boards/shields/blank_slate/Kconfig.shield
```kconfig
config  SHIELD_BLANK_SLATE_DONGLE
    def_bool $(shields_list_contains,blank_slate_dongle)
```

## config/west.yml
```yaml
manifest:
  defaults:
    revision: v0.3
  remotes:
    - name: zmkfirmware
      url-base: https://github.com/zmkfirmware
    - name: keithtweed
      url-base: https://github.com/keithtweed
    - name: englmaxi
      url-base: https://github.com/englmaxi
  projects:
    - name: zmk
      remote: zmkfirmware
      import: app/west.yml
      revision: main
    - name: blank-slate-zmk-module
      url: https://github.com/keithtweed/blank-slate-zmk-module
      revision: main
      path: modules/blank-slate-zmk-module
    - name: zmk-dongle-display
      remote: englmax
      version: main
  self:
    path: config
```
